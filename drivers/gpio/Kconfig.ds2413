## drivers/gpio/Kconfig.ds2413
```kconfig
# DS2413 Dual Channel Addressable Switch

# Copyright (c) 2021 Thomas Stranger
# SPDX-License-Identifier: Apache-2.0

config GPIO_DS2413
	bool "DS2413 Dual Channel Addressable Switch"
	depends on W1_NET
	help
	  Enable driver for DS2413 Dual Channel Addressable Switch

if GPIO_DS2413

config GPIO_DS2413_INIT_PRIORITY
	int "Init priority"
	default 75
	help
	  Device driver initialization priority.

endif # GPIO_DS2413
```

## drivers/sensor/scd4x/Kconfig
```kconfig
# Copyright (c) 2021 Thomas Stranger
# SPDX-License-Identifier: Apache-2.0

menuconfig SCD4X
	bool "SCD4X C02 Sensor"
	depends on I2C && HAS_DTS_GPIO
	help
	  Enable driver for Sensirion SCD4X sensors.

if SCD4X

choice
	prompt "Measurement Mode"
	default SCD4X_MEASURE_PERIODIC_HPM
	help
	  Specify the measurement mode.

config SCD4X_MEASURE_PERIODIC_HPM
	bool "Periodic high performance measurement mode"
	help
	  low power mode measures continuously with update interval of 5s

config SCD4X_MEASURE_PERIODIC_LPM
	bool "Periodic low power measurement mode"
	help
	  low power mode measures continuously with update interval of 30s

config SCD4X_MEASURE_SINGLE_SHOT
	bool "Single shot measurement mode"
	depends on ($(dt_node_has_bool_prop,scd41-62,single-shot-support)) || \
		 ($(dt_node_has_bool_prop,scd4x-1,single-shot-support)) || \
		 ($(dt_node_has_bool_prop,scd4x-2,single-shot-support)) || \
		 ($(dt_node_has_bool_prop,i2c-0,scd41-62)) || \
		 ($(dt_node_has_bool_prop,i2c-1,scd41-62)) || \
		 y
	help
	  single shot mode measures only on-demand. TODO

endchoice

config SCD4X_MEASURE_MODE_RUNTIME_CHANGE
	bool "Runtime measuremnt mode change"
	help
	  Enables possibility to change the measurement mode at runtime.
	  Therefore the sensor attribute SENSOR_ATTR_SAMPLING_FREQUENCY for
	  SENSOR_CHAN_ALL is used.
	  The value 0.0Hz turns off periodic measurements, such that the sensor
	  is usable in single shot mode(SCD41 only).
	  Values greater than 0.033333Hz enable the HPM, which samples
	  values at 5s interval.
	  Positive vales smaller or equal 0.033333Hz enable the LPM,
	  which samples at 30s interval.

config SCD4X_FORCED_CALIBRATION_SUPPORT
	bool "Forced calibration support"
	help
	  The SCD4x Sensor runs an automatic calibration in the background,
	  which assumes that the sensor is exposed to the atmospheric
	  CO2 concentration of 400 ppm at least once per week.

	  Additionally a forced calibration method is provided via the
	  sensor attribute interface:
	  Using SENSOR_ATTR_CALIB_TARGET for SENSOR_CHAN_CO2 a CO2 reference
	  value can be supplied for calibration. For successful calibration
	  the Sensor must have operated in periodic mode for more than 3
	  minutes before the initiation of the calibration.

	  The special values 0.0 and 0.000001 can be used to disable and
	  enable the automatic calibration at runtime.


config SCD4X_FACTORY_RESET_AT_INIT
	bool "Execute factory reset during initialization"
	help
	  Execute factory reset during driver initialization.
	  This resets all configuration settings stored in the eeprom and erases
	  the FRC and ASC algorithm history.

config SCD4X_SELFTEST_AT_INIT
	bool "Execute self-test during initialization"
	help
	  Execute self-test during driver initialization.
	  Can be used as end-of-line test to confirm sensor functionality.

endif # SCD4X
```

## drivers/sensor/shtcx/Kconfig
```kconfig
# SHTCX temperature and humidity sensor configuration options

# Copyright (c) 2021 Thomas Stranger
# SPDX-License-Identifier: Apache-2.0

menuconfig SHTCX
	bool "SHTCX: SHTC1 and SHTC3 Temperature and Humidity Sensor"
	depends on I2C
	help
	  Enable driver for SHTC1 and SHTC3 temperature and humidity sensors.

if SHTCX

choice
	prompt "Measurement mode"
	default SHTCX_MODE_NORMAL

config SHTCX_MODE_NORMAL
	bool "normal mode"

config SHTCX_MODE_LOW_POWER
	bool "low power mode"

endchoice

endif # SHTCX
```

## dts/bindings/can/st,stm32-fdcan.yaml
```yaml
description: Bosch m_can CAN-FD controller

compatible: "st,stm32-fdcan"

include: bosch-mcan.yaml

properties:
    pinctrl-0:
      type: phandles
      required: false
      description: |
        GPIO pin configuration for CAN signals (RX, TX). We expect
        that the phandles will reference pinctrl nodes.

        For example the can1 would be
           pinctrl-0 = <&fdcan1_rx_pa11 &fdcan1_tx_pa12>;

    shared-irq-names:
        type: string-array
        required: false
        description: |
          Name of each shared-irq in shared-irqs.
          Required if shared-irqs are used.

    shared-irqs:
        type: phandle-array
        required: false
        description: |
          To avoid interrupt conflicts shared-irq nodes can be referenced.
          When shared-irqs are defined with matching names,
          the driver registers the isr in the shared-irq driver instead of
          connecting to the interrupt defined in the interrupts array.

          example overlay for stm32g0b1

          &shared_irq21: {
              status = "okay";
          };

          &shared_irq22 {
              status = "okay";
          };

          &can1 {
              shared-irqs = <&shared_irq21 &shared_irq22>;
              shared-irq-names = "LINE_0", "LINE_1";
          };

          &can2 {
              shared-irqs = <&shared_irq21 &shared_irq22>;
              shared-irq-names = "LINE_0", "LINE_1";
          };
```

## dts/bindings/gpio/maxim,ds2413.yaml
```yaml
# Copyright (c) 2021, Thomas Stranger
# SPDX-License-Identifier: Apache-2.0

# Dual channel 1-wire open-drain I/O.
# Up to 20mA sink current and 28V off-state operating voltage
# Communication in normal and overdrive speed.

description: Maxim 1-Wire Dual Channel Addressable Switch

compatible: "maxim,ds2413"

include: w1-slave.yaml

# properties:
    # resolution:
    #   type: int
    #   required: true
    #   description: |
    #       Resolution of the temperature reading in bit.
    #       Valid configurations are from 9 to 12 bits.
```

## dts/bindings/sensor/sensirion,scd4x.yaml
```yaml
# Copyright (c) 2021, Thomas Stranger
# SPDX-License-Identifier: Apache-2.0

description: Sensirion SCD4x CO2 sensor

compatible: "sensirion,scd4x"

include: i2c-device.yaml

properties:
    single-shot-support:
      type: boolean
      required: false
      description: |
        If the Sensor supports single shot measurements(SHT41 only).
```

## dts/bindings/serial/st,stm32-usart.yaml
```yaml
description: STM32 USART

compatible: "st,stm32-usart"

include: uart-controller.yaml

properties:
    reg:
      required: true

    interrupts:
      required: true

    shared-irq:
        type: phandle
        required: false
        description: |
          In case of interrupt conflict a shared interrupt controller can
          be specified which dispaches to all consumers.
          When the shared-irq phandle is defined, it will be automatically
          used insted of the direct interrupt defined in interrupts
          property.
          TODO why does st,stm32-usart exist

    parity:
      required: false
      type: int
      description: |
        Configures the parity of the adapter. Value 0 for none, 1 for odd
        and 2 for even parity.  Default to none if not specified.

    pinctrl-0:
      type: phandles
      required: false
      description: |
        GPIO pin configuration for serial signals (RX, TX, RTS, CTS).  We expect
        that the phandles will reference pinctrl nodes.

        For example the USART1 would be
           pinctrl-0 = <&usart1_tx_pb6 &usart1_rx_pb7>;
```
