/*
 * Copyright (c) 2020 Linaro Limited
 * Copyright (c) 2021 Thomas Stranger
 *
 * SPDX-License-Identifier: Apache-2.0
 */

#include <arm/armv8-m.dtsi>
#include <dt-bindings/gpio/gpio.h>
#include <dt-bindings/i2c/i2c.h>
#include <dt-bindings/pwm/pwm.h>

/ {
	soc {
		peripheral: peripheral@40000000 {
			/* necessary to avoid warning: node has no reg property*/
			ranges = <0x40000000 0x40000000 0x10000000>;
		};
	};

	sram0: memory@20000000 {
		compatible = "mmio-sram";
	};
};

#include "stm32l5_common.dtsi"
