/*
 * Copyright (c) 2021 Thomas Stranger
 *
 * SPDX-License-Identifier: Apache-2.0
 */

#include <mem.h>
#include <st/l5/stm32l562_ns.dtsi>

&sram0 {
	reg = <0x20000000 DT_SIZE_K(192)>;
};

&flash0 {
	reg = <0x08000000 DT_SIZE_K(512)>;
};
