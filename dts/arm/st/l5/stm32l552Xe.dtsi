/*
 * Copyright (c) 2020 Linaro Limited
 *
 * SPDX-License-Identifier: Apache-2.0
 */
#include <mem.h>
#include <st/l5/stm32l552.dtsi>

&sram0 {
	reg = <0x30000000 DT_SIZE_K(192)>;
};

&flash0 {
	reg = <0x08000000 DT_SIZE_K(512)>;
	/* reg = <0x0 DT_SIZE_K(512)>; */
};
